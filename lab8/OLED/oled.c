#include "oled.h"
#include "soft_i2c.h"
#include <stdio.h>
#include <string.h>

/* 6x8 点阵字库，覆盖 ASCII 32(空格) ~ 127 */
static const uint8_t F6x8[][6] = {
    {0x00, 0x00, 0x00, 0x00, 0x00, 0x00}, {0x00, 0x00, 0x00, 0x2f, 0x00, 0x00},
    {0x00, 0x00, 0x07, 0x00, 0x07, 0x00}, {0x00, 0x14, 0x7f, 0x14, 0x7f, 0x14},
    {0x00, 0x24, 0x2a, 0x7f, 0x2a, 0x12}, {0x00, 0x23, 0x13, 0x08, 0x64, 0x62},
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    {0x00, 0x08, 0x04, 0x08, 0x10, 0x08}};

/**
 * @brief  向 SSD1306 写一个字节
 * @param  dat 数据
 * @param  cmd 1 = 命令（控制字节 0x40），0 = 显存数据（控制字节 0x00）
 * @note   一次完整事务：START + 从机地址 + 控制字节 + 数据 + STOP
 */
static void OLED_WR_Byte(uint8_t dat,
                         uint8_t cmd) // 作用是向 SSD1306 写一个字节数据或命令
{
  SoftI2C_Start();
  SoftI2C_SendByte(OLED_ADDR);
  SoftI2C_WaitAck();
  SoftI2C_SendByte(cmd ? 0x40 : 0x00);
  SoftI2C_WaitAck();
  SoftI2C_SendByte(dat);
  SoftI2C_WaitAck();
  SoftI2C_Stop();
}

/**
 * @brief  设置显存写入位置
 * @param  x 列地址 0~127
 * @param  y 页地址 0~7
 */
static void OLED_SetPos(uint8_t x, uint8_t y) {
  OLED_WR_Byte(0xB0 + y, 0);          /* 设置页地址 */
  OLED_WR_Byte(0x00 + (x & 0x0F), 0); /* 列地址低 4 位 */
  OLED_WR_Byte(0x10 + (x >> 4), 0);   /* 列地址高 4 位 */
}

/**
 * @brief  初始化 SSD1306
 */
void OLED_Init(void) {
  HAL_Delay(100); /* 等待 OLED 上电稳定 */

  OLED_WR_Byte(0xAE, 0); /* 关闭显示 */
  OLED_WR_Byte(0x20, 0); /* 页寻址模式 */
  OLED_WR_Byte(0x10, 0);
  OLED_WR_Byte(0xB0, 0);
  OLED_WR_Byte(0xC8, 0); /* 扫描方向：从下到上 */
  OLED_WR_Byte(0x00, 0);
  OLED_WR_Byte(0x10, 0);
  OLED_WR_Byte(0x40, 0); /* 起始行 = 0 */
  OLED_WR_Byte(0x81, 0); /* 对比度 */
  OLED_WR_Byte(0xFF, 0);
  OLED_WR_Byte(0xA1, 0); /* 左右方向：从左到右 */
  OLED_WR_Byte(0xA6, 0); /* 正常显示（非反色） */
  OLED_WR_Byte(0xA8, 0); /* 复用率 */
  OLED_WR_Byte(0x3F, 0); /* 1/64 */
  OLED_WR_Byte(0xA4, 0); /* 输出跟随显存 */
  OLED_WR_Byte(0xD3, 0); /* 显示偏移 */
  OLED_WR_Byte(0x00, 0);
  OLED_WR_Byte(0xD5, 0); /* 时钟分频 */
  OLED_WR_Byte(0xF0, 0);
  OLED_WR_Byte(0xD9, 0); /* 预充电周期 */
  OLED_WR_Byte(0x22, 0);
  OLED_WR_Byte(0xDA, 0); /* COM 引脚配置 */
  OLED_WR_Byte(0x12, 0);
  OLED_WR_Byte(0xDB, 0); /* VCOMH 电压 */
  OLED_WR_Byte(0x20, 0);
  OLED_WR_Byte(0x8D, 0); /* 电荷泵 */
  OLED_WR_Byte(0x14, 0);
  OLED_WR_Byte(0xAF, 0); /* 开启显示 */

  OLED_Clear();
}

/**
 * @brief  清屏：8 页 × 128 列全部写 0
 */
void OLED_Clear(void) {
  for (uint8_t i = 0; i < 8; i++) {
    OLED_WR_Byte(0xB0 + i, 0);
    OLED_WR_Byte(0x00, 0);
    OLED_WR_Byte(0x10, 0);
    for (uint8_t j = 0; j < 128; j++) {
      OLED_WR_Byte(0x00, 1);
    }
  }
}

/**
 * @brief  在 (x, y) 处显示一个 ASCII 字符（6x8）
 * @param  x 像素列坐标，y 页坐标
 */
void OLED_ShowChar(uint8_t x, uint8_t y, char ch) {
  uint8_t c;

  /* 字库只覆盖 ASCII 32~127，超范围按空格处理，避免数组越界读 */
  if ((uint8_t)ch < 32 || (uint8_t)ch > 127)
    ch = ' ';

  c = (uint8_t)(ch - 32);

  if (x > 127) /* 越界则换到下一页行首 */
  {
    x = 0;
    y++;
  }

  OLED_SetPos(x, y);
  for (uint8_t i = 0; i < 6; i++) {
    OLED_WR_Byte(F6x8[c][i], 1);
  }
}

/**
 * @brief  显示字符串
 */
void OLED_ShowString(uint8_t x, uint8_t y, const char *str) {
  while (*str) {
    OLED_ShowChar(x, y, *str);
    x += 6;
    str++;
  }
}

/**
 * @brief  显示无符号整数
 * @param  len 固定显示宽度，不足时左侧补空格（用于覆盖旧内容）
 */
void OLED_ShowNum(uint8_t x, uint8_t y, uint32_t num, uint8_t len) {
  char buf[16];
  uint8_t l;

  sprintf(buf, "%lu", num);
  l = (uint8_t)strlen(buf);

  for (uint8_t i = 0; i < len - l; i++) {
    OLED_ShowChar(x, y, ' ');
    x += 6;
  }
  OLED_ShowString(x, y, buf);
}
